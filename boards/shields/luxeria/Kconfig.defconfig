## boards/shields/luxeria/Kconfig.defconfig
```kconfig
# Copyright (c) 2024 The ZMK Contributors
# SPDX-License-Identifier: MIT

if SHIELD_LUXERIA_LEFT

config ZMK_KEYBOARD_NAME
    default "Luxeria"

config ZMK_SPLIT_ROLE_CENTRAL
    default n

config I2C
    default y

config SSD1306
    default y

config ZMK_DISPLAY
    select LV_USE_CONT
    select LV_FONT_MONTSERRAT_26

if ZMK_DISPLAY

config LV_Z_VDB_SIZE
    default 64

config LV_DPI_DEF
    default 58

config LV_Z_BITS_PER_PIXEL
    default 1

choice LV_COLOR_DEPTH
    default LV_COLOR_DEPTH_1
endchoice

endif

endif

if SHIELD_LUXERIA_RIGHT

config ZMK_KEYBOARD_NAME
    default "Luxeria"

config ZMK_SPLIT_ROLE_CENTRAL
    default y

config INPUT
    bool
    default y

config SPI
    bool
    default y

config ZMK_POINTING
    bool
    default y

endif

if SHIELD_LUXERIA_LEFT || SHIELD_LUXERIA_RIGHT

config ZMK_SPLIT
    default y

endif
```

## config/west.yml
```yaml
manifest:
  remotes:
    - name: zmkfirmware
      url-base: https://github.com/zmkfirmware
    - name: badjeff
      url-base: https://github.com/badjeff
  projects:
    - name: zmk
      remote: zmkfirmware
      revision: abb64ba316c29caddc49727ca2cac2f0ed5970c7  # Before Zephyr 4.1 update
      import: app/west.yml
    - name: zmk-pmw3610-driver
      remote: badjeff
      revision: main
  self:
    path: config
```

## trackball example/config/west.yml
```yaml
manifest:
  remotes:
    - name: zmkfirmware
      url-base: https://github.com/zmkfirmware
    - name: george-norton
      url-base: https://github.com/george-norton
    # Additional modules containing boards/shields/custom code can be listed here as well
    # See https://docs.zephyrproject.org/3.2.0/develop/west/manifest.html#projects
  projects:
    - name: zmk
      remote: zmkfirmware
      revision: v0.2.1
      import: app/west.yml
    - name: zmk-driver-pmw3360
      remote: george-norton
      revision: main
  self:
    path: config
```
