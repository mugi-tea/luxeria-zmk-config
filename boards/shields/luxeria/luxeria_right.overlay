/*
 * Copyright (c) 2024 The ZMK Contributors
 * SPDX-License-Identifier: MIT
 */

#include "luxeria.dtsi"

// Seeeduino XIAO BLE Plus pinout:
// D0  = &xiao_d 0  (P0.02)
// D1  = &xiao_d 1  (P0.03)
// D2  = &xiao_d 2  (P0.28)
// D3  = &xiao_d 3  (P0.29)
// D4  = &xiao_d 4  (P0.04)
// D5  = &xiao_d 5  (P0.05)
// D11 = &gpio0 15  (P0.15)
// D12 = &gpio0 19  (P0.19)
// D13 = &gpio1 1   (P1.01)
// D14 = &gpio0 9   (P0.09)
// D15 = &gpio0 10  (P0.10)
// D16 = &gpio0 31  (P0.31)

&default_transform {
    col-offset = <7>;
};

&kscan0 {
    row-gpios
        = <&xiao_d 0 (GPIO_ACTIVE_HIGH | GPIO_PULL_DOWN)>
        , <&xiao_d 1 (GPIO_ACTIVE_HIGH | GPIO_PULL_DOWN)>
        , <&xiao_d 2 (GPIO_ACTIVE_HIGH | GPIO_PULL_DOWN)>
        , <&xiao_d 3 (GPIO_ACTIVE_HIGH | GPIO_PULL_DOWN)>
        , <&xiao_d 4 (GPIO_ACTIVE_HIGH | GPIO_PULL_DOWN)>
        ;
    col-gpios
        = <&xiao_d 5 GPIO_ACTIVE_HIGH>
        , <&gpio0 15 GPIO_ACTIVE_HIGH>
        , <&gpio0 19 GPIO_ACTIVE_HIGH>
        , <&gpio1 1 GPIO_ACTIVE_HIGH>
        , <&gpio0 9 GPIO_ACTIVE_HIGH>
        , <&gpio0 10 GPIO_ACTIVE_HIGH>
        , <&gpio0 31 GPIO_ACTIVE_HIGH>
        ;
};
